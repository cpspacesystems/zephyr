## drivers/sensor/melexis/Kconfig
```kconfig
# Copyright (c) 2024 Florian Weber <Florian.Weber@live.de>
# SPDX-License-Identifier: Apache-2.0

# zephyr-keep-sorted-start
source "drivers/sensor/melexis/mlx90394/Kconfig"
source "drivers/sensor/melexis/mlx90397/Kconfig"
# zephyr-keep-sorted-stop
```

## drivers/sensor/melexis/mlx90397/Kconfig
```kconfig
# Copyright (c) 2024 Florian Weber <Florian.Weber@live.de>
# SPDX-License-Identifier: Apache-2.0


config MLX90397
	bool "MLX90397 Magnetometer"
	default y
	depends on DT_HAS_MELEXIS_MLX90397_ENABLED
	select I2C
	help
	  Enable driver for MLX90397 magnetometer.
```

## dts/bindings/sensor/melexis,mlx90397.yaml
```yaml
# Copyright (c) Florian Weber <Florian.Weber@live.de>
# SPDX-License-Identifier: Apache-2.0

description: |
    Melexis MLX90397 Magnetometer. See datasheet at
    https://media.melexis.com/-/media/files/documents/datasheets/mlx90394-datasheet-melexis.pdf

compatible: "melexis,mlx90397"

include: [sensor-device.yaml, i2c-device.yaml]
```
